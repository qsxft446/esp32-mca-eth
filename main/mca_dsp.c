#include "mca_dsp.h"
#include "adc_cap.h"
#include "adc_clk.h"

#include <string.h>
#include <stdlib.h>
#include "freertos/FreeRTOS.h"
#include "freertos/semphr.h"
#include "esp_timer.h"
#include "esp_heap_caps.h"
#include "esp_attr.h"
#include "esp_cpu.h"
#include "esp_log.h"

static const char *TAG = "mca_dsp";

/* ======================================================================
 * АРХИТЕКТУРА (переработана после замеров реального сигнала)
 *
 * Сигнал с зарядочувствительного предусилителя: быстрый фронт 200-800 нс
 * и ДЛИННЫЙ экспоненциальный спад (tau ~ 21 мкс). При скорости счёта
 * 10 000/с новый импульс почти всегда приходит на недоспавший хвост
 * предыдущего - сигнал превращается в "лестницу", абсолютного нуля
 * между импульсами не существует.
 *
 * Поэтому порог сравнивается НЕ с сырым отсчётом, а с выходом
 * трапецеидального фильтра. Трапеция - это разность двух скользящих
 * окон: медленный хвост входит в оба почти одинаково и вычитается,
 * а ступенька нового импульса - нет. Дифференциальность получается
 * бесплатно, отдельный триггер не нужен.
 *
 * Следствие: трапецию надо считать на КАЖДОМ отсчёте, а не только
 * вокруг события. Поэтому используется рекурсивная форма Джорданова
 * (O(1) на отсчёт), а не пересуммирование окна:
 *
 *   trap[n] = trap[n-1] + v[n] - v[n-L] - v[n-G] + v[n-G-L]
 *
 * Это математически то же самое, что (сумма окна L) - (сумма окна L,
 * сдвинутого на G), но 4 обращения к кольцу вместо 2L.
 * ====================================================================== */

static uint32_t     *s_hist;
static mca_params_t  s_par;
static mca_stats_t   s_st;
/* БЛОКИРОВКА - СПИН, А НЕ МЬЮТЕКС. Под ней только копии нескольких
 * слов. Раньше был мьютекс, и «Применить» / «Сброс» держали его, пока
 * чистили гистограмму в PSRAM и печатали в консоль (по UART это
 * миллисекунды), а задача обработки ждала его на каждом чанке - при
 * запасе очереди захвата 1.6 мс на 20 МГц это верные потери. К тому же
 * держателя мьютекса на ядре 0 вытесняет WiFi, и ожидание растягивалось. */
static portMUX_TYPE s_mux = portMUX_INITIALIZER_UNLOCKED;
#define LOCK()   portENTER_CRITICAL(&s_mux)
#define UNLOCK() portEXIT_CRITICAL(&s_mux)

/* Запросы других задач (под LOCK). Выполняет их сама задача обработки в
 * mca_dsp_service: только она пишет в гистограмму и состояние фильтра. */
static bool     s_req_clear, s_req_prime;
/* Очистка гистограммы кусками: следующий канал, -1 - очистки нет. */
static int32_t  s_clr_pos = -1;
#define CLR_BLOCK 1024

/* --- кольцо сырых отсчётов + рекурсивный аккумулятор --- */
static int32_t  s_trap;          /* текущее значение трапеции */

/* Линейный рабочий буфер: хвост прошлого чанка + текущий чанк.
 * Раньше здесь было кольцо с маской, и каждое из трёх обращений
 * стоило вычитания, наложения маски и расчёта адреса - около
 * тридцати инструкций на отсчёт, потолок около 3.5 МГц. В линейном
 * буфере отсчёты берутся простым смещением по фиксированному сдвигу. */
#define DSP_TAIL CAP_HEAD_SAMPLES
/* Выровнен на 16 байт: векторная разность (diff_vec) читает отсчёт
 * w[i] выровненными 128-битными словами, начиная с s_work + DSP_TAIL,
 * а переворот полярности пишет сюда 32-битными. Запас в 16 отсчётов
 * в конце: последняя восьмёрка читает до 7 отсчётов за краем чанка. */
static uint16_t s_work[DSP_TAIL + CAP_CHUNK_SAMPLES + 16] __attribute__((aligned(16)));
_Static_assert(DSP_TAIL % 8 == 0, "s_work + DSP_TAIL должен быть выровнен на 16 байт");

/* ТЕКУЩИЙ РАБОЧИЙ БУФЕР: хвост прошлого чанка + этот чанк. Обычно это сам
 * буфер DMA - перед данными у него место под хвост (adc_cap.c), и копируется
 * только хвост, 200 отсчётов, а не весь чанк: копия всего чанка стоила 1.43
 * такта на отсчёт из бюджета 12 на 20 МГц (замер 2026-11-04). s_work - для
 * импульсов вниз (их переворачиваем при копии) и когда очередь почти полна:
 * тогда DMA скоро запишет в этот же буфер, и данные надо унести. Хвост между
 * чанками хранится в s_tail. */
static uint16_t *s_w = s_work;
static uint16_t  s_tail[DSP_TAIL];

/* Разность трапеции d[i] = w[i] - w[i-L] - w[i-G] + w[i-G-L] для
 * отсчётов текущего чанка: s_d[k] относится к s_w[DSP_TAIL + k].
 * Считается сразу для всего чанка, дальше вся обработка берёт готовое
 * значение - одно чтение на отсчёт вместо четырёх. Значения в пределах
 * ±8190, в 16 бит помещаются. Запас в 16 - под последнюю восьмёрку. */
static int16_t s_d[CAP_CHUNK_SAMPLES + 16] __attribute__((aligned(16)));
#define DD(i) s_d[(i) - DSP_TAIL]

/* Векторный путь включается только после самопроверки при старте
 * (mca_dsp_vec_init): не прошла - считаем разность обычным кодом. */
static bool s_vec_ok;

/* Счётчики, которые копит только задача обработки, без мьютекса;
 * в статистику они уходят раз на чанк (см. конец mca_dsp_process). */
static uint32_t s_ev_pend, s_ovf_pend;   /* событий и зашкалов за чанк   */
static uint64_t s_busy_cyc;              /* тактов обработки с замера    */
/* Такты по этапам с замера (под LOCK): копия чанка, разность трапеции,
 * порог и события - и сколько отсчётов на них пришлось. */
static uint64_t s_cyc_acc[3], s_cyc_n;
/* Последняя секунда для истории CPS (под LOCK): событий и сколько
 * миллисекунд шёл набор. Миллисекунды - разностью округлённых вниз
 * накопленных, чтобы усечение не копилось. */
static uint32_t s_sec_counts, s_sec_dur_ms;
static uint64_t s_prev_run_ms;
static int64_t  s_load_t_us;             /* когда был прошлый замер      */

/* --- автомат детектора --- */
typedef enum { ST_IDLE = 0, ST_PEAK, ST_REARM } det_state_t;
static det_state_t s_state;
static int32_t  s_peak;          /* максимум трапеции в событии */
static int32_t  s_peak_pos;      /* индекс максимума в s_work   */
static int32_t  s_since;         /* отсчётов с начала фазы      */
static int32_t  s_pre_trap;      /* трапеция до события (для pileup) */
static int64_t  s_flat_sum;      /* сумма трапеции на плоской вершине */
static int32_t  s_flat_cnt;

/* --- baseline (для показа и диагностики; трапеция в нём не нуждается) --- */
static int32_t  s_base_fp;
static bool     s_base_init;
static int32_t  s_base_lost;

/* После сброса (разрыв потока, старт, смена L/G) буфер не описывает
 * непрерывный сигнал. Если сразу начать детектировать, скачок
 * от нулей к реальному уровню даст ложное событие с зашкальной
 * амплитудой - все такие валятся в последний канал и дают острый
 * пик у правого края спектра. Поэтому первые отсчёты после сброса
 * фильтр только прогревается, события не засчитываются. */
static bool     s_need_prime = true;
static int32_t  s_prime_left;

static uint64_t s_last_events;
/* ВРЕМЯ НАБОРА, нс: сумма длительностей обработанных чанков (отсчётов /
 * частота). Раньше время считалось как «сейчас минус момент сброса» и шло
 * от старта ESP32 - и при остановленном наборе, и на вкладке
 * осциллографа. Теперь оно растёт только когда спектр реально
 * набирается; потерянные чанки в него не входят, как и в сам спектр. */
static uint64_t s_run_ns;

/* --- фильтр формы (см. shape_check и mca_dsp.h) --- */
static int32_t   s_cross_pos;           /* где трапеция пробила порог (s_work) */
static uint32_t  s_whist[SHAPE_HB];     /* гистограмма ширины               */
static int32_t   s_whist_win;           /* окно, на котором она копится     */
static bool      s_req_hist_clear;      /* под LOCK                         */
static uint32_t  s_shp_chk_pend, s_shp_rej_pend;
/* Набор эталона. Пишет только задача обработки: ширины в s_learn и сумму
 * импульсов в s_wsum, пока s_learn_n < s_learn_need. Начать или прервать
 * его просят другие задачи (s_req_learn: 1 - начать, 2 - прервать), а
 * выполняет mca_dsp_service - так обнуление сумм не встретится с записью в
 * них. Итог досчитывает mca_dsp_shape_poll; s_learn_gen отличает набор,
 * начатый заново, от досчитываемого. */
static int16_t  *s_learn;
/* Средний импульс копится с совмещением по середине фронта: отсчёт i
 * импульса ложится в ячейку i - c50 + WOFF, где c50 - первый отсчёт фронта
 * выше половины высоты. Раньше импульсы совмещались по своему максимуму: на
 * широкой вершине его место шум бросает на ~13 отсчётов (замер 2026-11-04,
 * 59 импульсов), и средний импульс получал излом слева от вершины, которого
 * у самих импульсов нет. В ячейке - сумма и сколько импульсов в неё легло. */
#define WOFF (8 + 200)
#define WBUF (2 * SHAPE_WAVE_MAX)
static int32_t   s_wsum[WBUF];             /* сумма импульсов над базой, x8 */
static int16_t   s_wcnt[WBUF];
static volatile int32_t s_learn_n, s_learn_need;
static int32_t   s_req_learn;              /* под LOCK                      */
static uint32_t  s_learn_gen;
static int32_t   s_learn_win, s_learn_hz;  /* условия набора               */
static int32_t   s_lp10, s_lp50, s_lp90;   /* итог последнего набора        */
static mca_shape_wave_t s_wave;            /* эталонный импульс, под LOCK   */
static uint32_t  s_wave_gen;               /* растёт при каждом новом эталоне */
/* Копия эталона для свёртки - у задачи обработки, обновляется, когда
 * s_wave_gen сменился: отсчёты x256 от вершины, их число, середина фронта и
 * сумма квадратов. */
static int16_t   s_cr[SHAPE_WAVE_MAX];
static int32_t   s_cr_len, s_cr_mid, s_cr_pre, s_cr_r2;
static int32_t   s_cr_win_sum, s_cr_win_n;  /* эталон по окну «до / после» */
static uint32_t  s_cr_gen;
/* Примеры для страницы: [0] - в допуске, [1] - вне. Задача обработки
 * пишет в слот, только пока s_ex_want, потом ставит s_ex_new (под LOCK). */
static mca_shape_ex_t s_ex[2];
static bool      s_ex_want[2] = { true, true }, s_ex_new[2];
static volatile int32_t s_watch_s;         /* страница открыта, секунд      */

void mca_dsp_init(void)
{
    s_hist = heap_caps_calloc(MCA_CHANNELS, sizeof(uint32_t),
                              MALLOC_CAP_SPIRAM | MALLOC_CAP_8BIT);
    if (!s_hist) s_hist = calloc(MCA_CHANNELS, sizeof(uint32_t));

    /* Дефолты сняты с рабочей конфигурации другого прибора того же
     * класса (АЦП AD9235, тот же тип детектора):
     *   F 7000000  RISE 6  FALL 15  NOISE 30  HYST 1  STEP 5
     * отбраковка наложений там выключена - у нас тоже по умолчанию. */
    s_par = (mca_params_t){
        /* Порог задаётся в единицах ВЫХОДА ТРАПЕЦИИ, а не входного
         * шума. Проверено симуляцией: при шуме +-8 кодов трапеция
         * (L=6,G=15) даёт сигму ~17 и выбросы до 80, поэтому порог
         * должен быть 100-200. Значение NOISE 30 с того прибора
         * относится к их шумовым условиям и напрямую не переносится -
         * подбирать по реальному шуму (см. режим Осциллограф). */
        .threshold       = 20,
        .hysteresis      = 50,   /* % от порога для перезапуска   */
        /* ВАЖНО: у того прибора RISE=6 и FALL=15 - это части
         * ОДНОГО окна интегрирования, их сумма 21 отсчёт. У нас L и
         * есть это окно, поэтому переносить их числа как L=6, G=15
         * было неверно: мы интегрировали шестую часть от того, что
         * они. Берём L=20 (близко к их 21) и G с запасом на фронт. */
        .trap_L          = 20,
        .trap_G          = 44,
        .rearm           = 64,   /* L+G: трапеция возвращается к 0 */
        .search          = 70,   /* чуть больше L+G               */
        /* Способ измерения амплитуды. Обнаружение события в обоих
         * случаях одинаковое - по выходу трапеции: порог по сырому
         * сигналу при длинном хвосте не работает. Различается только
         * то, как считается величина уже найденного импульса. */
        .algo            = 0,
        .polarity        = 0,
        .int_rise        = 20,
        .int_fall        = 32,
        /* 1 код амплитуды на канал и 2048 каналов: при базе в середине
         * АЦП (запас вверх 2047 кодов) шкала занята целиком. */
        .cpc_milli       = 1000,
        .nch             = 2048,
        .baseline_shift  = 10,
        .baseline_win    = 150,
        .pileup_pre_pct  = 0,    /* 0 = выключено                 */
        .pileup_post_pct = 0,
        /* Усреднение по плато ВЫКЛЮЧЕНО по умолчанию.
         * Проверено симуляцией: выигрыш появляется только при длинном
         * плато (G-L >= ~19). При наших дефолтах (плато 9) максимум
         * даёт даже чуть меньший разброс - соседние отсчёты трапеции
         * сильно скоррелированы, усреднять почти нечего.
         * Смещение максимума (растёт с шумом) - постоянный сдвиг
         * для всех амплитуд, уходит в калибровку и ширину пиков
         * не портит. */
        .flat_avg        = 0,
        /* Фильтр формы выключен: с хорошим ФЭУ и его родным питанием он
         * не нужен. Допуск 25 %: на шумном ФЭУ этого прибора (2026-11-03,
         * 20 МГц) ширина сцинтилляций держится в ±8 %, а шумовые всплески
         * втрое уже. */
        .shape_on        = 0,
        .shape_tol       = 25,
        /* в эталон: выше трёх порогов, без верхней границы (зашкалившие не
         * берутся никогда), 2000 импульсов */
        .shape_lmin      = 0,
        .shape_lmax      = 0,
        .shape_ln        = SHAPE_LEARN_N,
    };
    s_learn = heap_caps_calloc(SHAPE_LEARN_N, sizeof(int16_t),
                               MALLOC_CAP_SPIRAM | MALLOC_CAP_8BIT);
    if (!s_learn)
        ESP_LOGE(TAG, "нет памяти под эталон формы - набрать его не выйдет");

    memset(s_work, 0, sizeof(s_work));
    s_trap = 0; s_state = ST_IDLE;
    s_need_prime = true;
    s_base_fp = 0;
    s_run_ns = 0;
    ESP_LOGI(TAG, "DSP готов: рекурсивная трапеция, порог по её выходу");
}

/* Обнулить счётчики набора. Под LOCK. Гистограмму чистит mca_dsp_service. */
static void stats_clear_locked(void)
{
    s_st.total_events      = 0;
    s_st.skipped_pileup    = 0;
    s_st.skipped_deadtime  = 0;
    s_st.samples_processed = 0;
    s_st.overflow          = 0;  /* раньше не сбрасывался: «отброшенные» для
                                    программ на ПК копились через «Сброс» */
    s_st.shape_checked     = 0;
    s_st.skipped_shape     = 0;
    s_req_hist_clear       = true;
    s_last_events = 0;
    s_run_ns      = 0;
    s_st.run_ms   = 0;          /* страница увидит ноль сразу, не через тик */
}

void mca_dsp_reset_spectrum(void)
{
    LOCK();
    s_req_clear = true;
    UNLOCK();
}

/* ЗАПРОСЫ ДРУГИХ ЗАДАЧ выполняет сама задача обработки: зовётся на каждом
 * чанке (idle = false) и при простое захвата, раз в 100 мс (idle = true).
 *
 * Гистограмма - 32 КБ в PSRAM; целиком её очистка дольше, чем запас
 * очереди захвата, поэтому на потоке она идёт кусками по CLR_BLOCK
 * каналов на чанк. Пока она идёт, спектр не набирается (mca_dsp_process
 * пропускает чанки, и время набора за них не идёт) - иначе события
 * попадали бы в ещё не очищенные каналы. На простое - сразу целиком. */
void mca_dsp_service(bool idle)
{
    LOCK();
    const bool prime = s_req_prime, clear = s_req_clear;
    s_req_prime = s_req_clear = false;
    if (clear) stats_clear_locked();
    const bool hist_clear = s_req_hist_clear;
    s_req_hist_clear = false;
    const int32_t rl = s_req_learn;
    s_req_learn = 0;
    if (rl == 2) s_learn_need = 0;
    UNLOCK();
    if (hist_clear) memset(s_whist, 0, sizeof(s_whist));
    if (rl == 1 && s_learn) {
        /* 2.4 КБ во внутренней памяти - микросекунды */
        memset(s_wsum, 0, sizeof(s_wsum));
        memset(s_wcnt, 0, sizeof(s_wcnt));
        LOCK();
        s_learn_gen++;
        s_learn_n    = 0;
        s_learn_win  = s_par.int_rise + s_par.int_fall + 1;
        s_learn_hz   = (int32_t)adc_clk_get_freq();
        s_learn_need = s_par.shape_ln;
        UNLOCK();
    }

    if (prime || clear) {
        s_trap       = 0;
        s_state      = ST_IDLE;
        s_need_prime = true;
        s_base_init  = false;      /* перезахватить ноль заново */
        s_base_lost  = 0;
    }
    if (clear) s_clr_pos = 0;
    if (s_clr_pos < 0) return;

    int32_t cnt = idle ? MCA_CHANNELS : CLR_BLOCK;
    if (cnt > MCA_CHANNELS - s_clr_pos) cnt = MCA_CHANNELS - s_clr_pos;
    memset(s_hist + s_clr_pos, 0, (size_t)cnt * sizeof(uint32_t));
    s_clr_pos += cnt;
    if (s_clr_pos >= MCA_CHANNELS) s_clr_pos = -1;
}

/* ПРОСТОЕ ИНТЕГРИРОВАНИЕ.
 *
 * Сумма отсчётов от вершины минус rise до вершины плюс fall,
 * с вычтенной базовой линией. Для сцинтиллятора с ФЭУ это
 * физически корректная величина: энергия пропорциональна
 * полному заряду, то есть площади импульса.
 *
 * Проверено симуляцией: разброс около 2.5 % против 0.6 % у
 * трапеции с компенсацией. Разница возникает из-за дрожания
 * положения вершины: импульс несимметричный, и сдвиг окна на
 * отсчёт заметно меняет сумму. В итоговом спектре с NaI это
 * даёт 7.44 % против 7.02 % - почти неразличимо, зато настройка
 * куда понятнее: два числа прямо с экрана.
 *
 * Возвращает сумму, а число отсчётов - в *out_n. Амплитуда - их
 * отношение, средняя высота импульса в окне в кодах АЦП; делится она
 * уже при записи в канал, целиком, без округления до кода. В *out_pk -
 * найденная вершина: её и сумму окна берёт фильтр формы, чтобы не искать
 * и не складывать то же самое второй раз.
 */
static int64_t amp_integrate(int32_t peak_pos, int32_t rise, int32_t fall,
                             int32_t L, int32_t G, int32_t base,
                             int32_t *out_n, int32_t *out_pk)
{
    int total = DSP_TAIL + CAP_CHUNK_SAMPLES;

    /* Вершина трапеции отстаёт от вершины сигнала примерно на L,
     * поэтому настоящий максимум ищем левее - но не раньше, чем «порог
     * пробит минус L»: порог пробивается не позже, чем через L отсчётов
     * после начала фронта. Раньше поиск шёл от вершины трапеции минус L+G
     * (~100 отсчётов, ~700 тактов на событие - замер 2026-11-04, 20 МГц) и
     * при наложении мог взять вершину предыдущего импульса. */
    int lo = peak_pos - L - G;
    if (lo < s_cross_pos - L) lo = s_cross_pos - L;
    int hi = peak_pos + 4;
    if (lo < 1) lo = 1;
    if (hi >= total) hi = total - 1;

    int32_t mx = -32768, pk = lo;
    for (int i = lo; i <= hi; i++)
        if (s_w[i] > mx) { mx = s_w[i]; pk = i; }

    *out_pk = pk;
    int a = pk - rise, b = pk + fall;
    if (a < 0) a = 0;
    if (b >= total) b = total - 1;

    int64_t sum = 0;
    for (int i = a; i <= b; i++) sum += (int32_t)s_w[i] - base;

    int n = b - a + 1;
    *out_n = n > 0 ? n : 1;
    return n > 0 ? sum : 0;
}

/* Номер канала = амплитуда / «кодов на канал». Амплитуда приходит
 * дробью num/den (трапеция: вершина / L, интегрирование: сумма / число
 * отсчётов) и делится целиком в 64 битах. Округлять её до целого кода
 * заранее нельзя: при долях кода на канал (0.5, 0.25) заняты были бы
 * только каналы, кратные 2 или 4, и спектр стал бы «гребёнкой». */
static void record_event(int64_t num, int32_t den, const mca_params_t *p)
{
    int64_t d  = (int64_t)den * p->cpc_milli;
    int64_t ch = (d > 0 && num > 0) ? num * 1000 / d : 0;

    /* Зашкалившие события ВЫБРАСЫВАЕМ, а не прижимаем к последнему
     * каналу. Раньше они там копились и выглядели как настоящий
     * острый пик у правого края спектра. */
    /* Без мьютекса. Раньше он брался и отпускался на КАЖДОЕ событие -
     * сотни тактов. В гистограмму пишет только задача обработки, а
     * читателю (веб) недописанный на мгновение канал не страшен.
     * Счётчики копятся локально и уходят в статистику раз на чанк, под
     * той блокировкой, что и так берётся в конце mca_dsp_process. */
    if (ch >= MCA_CHANNELS) {
        s_ovf_pend++;
        return;
    }
    s_hist[ch]++;
    s_ev_pend++;
}

/* Сумма 32 отсчётов базы, кончающихся перед e (e - 32 >= 0). */
static inline int32_t shape_base32(int e)
{
    int32_t b = 0;
    for (int i = e - 32; i < e; i++) b += s_w[i];
    return b;
}

/* АМПЛИТУДА СВЁРТКОЙ С ЭТАЛОНОМ (algo = 2). Эталон фильтра формы - средняя
 * форма импульса; амплитуда - высота, при которой он лучше всего (по сумме
 * квадратов) ложится на импульс: A = sum(x*r) / sum(r*r). Для известной
 * формы и белого шума это лучшая оценка высоты - в неё идёт весь импульс с
 * весом своей доли сигнала (так берёт высоту и BecqMoni для звуковой карты).
 * Вершину ищем, как интегрирование; импульс совмещается с эталоном по
 * середине фронта, как при наборе эталона.
 *
 * БАЗА - 32 отсчёта, кончающиеся за L до пробоя порога (shape_base): фронт
 * начинается не позже. Прежде база бралась прямо перед окном «до вершины», а
 * фронт бывает длиннее этого окна - база ложилась на фронт (у эталона в
 * начале было -0.40 вместо 0), и свёртка проигрывала: на 19 тыс. сырых
 * импульсов (2026-11-04, 20 МГц, окно 10 + 50) FWHM фотопика 11.75 % против
 * 9.25 % у трапеции; с базой от пробоя порога - 9.00 %.
 *
 * ШКАЛА - как у интегрирования: высота x среднее эталона по окну «до /
 * после вершины», то есть то, что дало бы интегрирование чистого импульса
 * этой формы. Иначе при переключении способа спектр растягивался в 1.5-2
 * раза.
 *
 * КОНЕЦ ЧАНКА. Если хвост эталона не лёг в буфер, высота подгоняется по той
 * части, что легла (МНК по неполному окну: та же высота, чуть больше шум).
 * Прежде такое событие считалось трапецией - в другой шкале, и в спектре
 * выше пика вырастал второй, ~0.4 % событий (модель, длинный фронт).
 * false - не легла даже вершина эталона (или мусор), событие считается
 * трапецией. Амплитуда = *num / *den, в кодах. */
static bool amp_conv(int32_t peak_pos, int end, const mca_params_t *p,
                     int64_t *num, int32_t *den, int32_t *out_pk)
{
    int lo = peak_pos - p->trap_L - p->trap_G, hi = peak_pos + 4;
    if (lo < s_cross_pos - p->trap_L) lo = s_cross_pos - p->trap_L;
    if (lo < 1) lo = 1;
    if (hi > end - 1) hi = end - 1;
    int32_t mx = -1;
    int pk = lo;
    for (int i = lo; i <= hi; i++)
        if (s_w[i] > mx) { mx = s_w[i]; pk = i; }
    const int e = s_cross_pos - p->trap_L;
    if (e - 32 < 0) return false;
    const int32_t base32 = shape_base32(e);
    const int32_t base8 = base32 / 4;
    const int32_t h8 = mx * 8 - base8;
    if (h8 <= 0) return false;
    int c50 = pk;
    while (c50 > e && s_w[c50 - 1] * 16 - 2 * base8 > h8) c50--;
    const int s0 = c50 - s_cr_mid;
    if (s0 < 0) return false;
    int n = s_cr_len;
    int32_t r2 = s_cr_r2;
    if (s0 + n > end) {                 /* хвост за концом чанка */
        n = end - s0;
        if (n <= s_cr_pre) return false;
        r2 = 0;
        for (int j = 0; j < n; j++) r2 += s_cr[j] * s_cr[j];
        if (r2 <= 0) return false;
    }
    /* по 32 отсчёта в 32 битах: 131040 x 256 x 32 - в пределах int32 */
    int64_t acc = 0;
    for (int j0 = 0; j0 < n; j0 += 32) {
        const int j1 = j0 + 32 < n ? j0 + 32 : n;
        int32_t part = 0;
        for (int j = j0; j < j1; j++)
            part += ((int32_t)s_w[s0 + j] * 32 - base32) * s_cr[j];
        acc += part;
    }
    /* высота = acc * 256 / (32 * r2): x - коды x32, r - доли x256; в шкалу
     * интегрирования - x (сумма r по окну / 256) / число отсчётов окна */
    *num = acc * s_cr_win_sum / s_cr_win_n;
    *den = 32 * r2;
    *out_pk = pk;
    return true;
}

/* Копия эталона для свёртки: доли x256 от вершины. Зовёт задача обработки,
 * когда эталон сменился. */
static void conv_take_wave(const mca_params_t *p)
{
    static mca_shape_wave_t w;
    LOCK();
    w = s_wave;
    s_cr_gen = s_wave_gen;
    UNLOCK();
    int32_t r2 = 0;
    for (int j = 0; j < w.len; j++) {
        s_cr[j] = (int16_t)(w.v[j] * 256 / 1000);
        r2 += s_cr[j] * s_cr[j];
    }
    s_cr_len = r2 > 0 ? w.len : 0;
    s_cr_mid = w.mid;
    s_cr_pre = w.pre;
    s_cr_r2  = r2;
    /* окно интегрирования вокруг вершины эталона - для шкалы */
    int32_t ws = 0, wn = 0;
    for (int j = w.pre - p->int_rise; j <= w.pre + p->int_fall; j++)
        if (j >= 0 && j < w.len) { ws += s_cr[j]; wn++; }
    s_cr_win_sum = ws;
    s_cr_win_n   = wn > 0 ? wn : 1;
    if (ws <= 0) s_cr_len = 0;
}

/* Границы допуска фильтра формы (ширина x10): считаются раз на чанк. */
static int32_t s_shape_lo, s_shape_hi;

/* ФИЛЬТР ФОРМЫ. Зовётся раз на событие, а не на отсчёт. Деления - только
 * 32-битные: 64-битное на Xtensa - вызов библиотеки на сотни тактов, а на
 * 20 МГц при ~5000 имп/с запаса у ядра почти нет (замер 2026-11-04: с
 * 64-битным делением и допуском, считаемым на каждое событие, мера стоила
 * 0.20 такта на отсчёт из бюджета 12, и терялось ~145 чанков в секунду).
 *
 * Вершина - максимум сырого сигнала от «порог пробит минус L» до вершины
 * трапеции: сигнал достигает вершины после начала фронта, а порог
 * пробивается не позже, чем через L отсчётов после него. Окно - «до /
 * после вершины» (int_rise, int_fall, те же, что у интегрирования). Ширина
 * = площадь / высота, x10.
 *
 * БАЗА - 32 отсчёта, кончающиеся за L до пробоя порога, как у свёртки:
 * фронт начинается не позже. Прежде - 8 отсчётов прямо перед окном; но
 * вершина у импульса скруглена, шум сдвигает максимум на несколько
 * отсчётов позже, и база ложилась на фронт (до 60 % высоты): ширина
 * выходила ~11 вместо ~33, и фильтр отбрасывал настоящие импульсы - на
 * сырых кадрах Ra-226 (2026-11-04, 20 МГц, окно 10 + 36, допуск 40 %) 55 %
 * импульсов высотой 16-25 кодов, 44 % - 25-37, 12 % - 60-100. С базой от
 * пробоя - ни одного, а всплески отсеиваются так же.
 *
 * При интегрировании (ipk >= 0) вершину и сумму окна уже нашёл
 * amp_integrate - в том же окне «до / после вершины»: они и берутся (isum -
 * сумма отсчётов окна без вычета базы; при свёртке вершина есть, а суммы
 * нет - isum < 0, её считаем здесь). Иначе поиск и сумма - здесь; это
 * ~580 из ~650 тактов меры (замер 2026-11-04), и при ~5000 имп/с на 20 МГц
 * повтор этой работы переполнял бюджет ядра.
 *
 * Зовётся, только когда мера нужна: фильтр, набор эталона или открытая
 * страница. Гистограмма ширины пополняется всегда; learn - идёт набор
 * эталона; cmp - эталон годится для сравнения (окно и частота те же);
 * filt - фильтр действует. true - событие идёт в спектр. Окно, не легшее
 * в буфер (событие у самого конца чанка), не судим: событие проходит. */
static bool shape_check(int32_t tpk, int end, int64_t num, int32_t den,
                        const mca_params_t *p, bool cmp, bool filt, bool learn,
                        int32_t ipk, int32_t isum)
{
    int32_t mx = -1;
    int pk;
    if (ipk >= 0) {
        pk = ipk;
        mx = s_w[pk];
    } else {
        int lo = s_cross_pos - p->trap_L, hi = tpk + 4;
        if (lo < 1) lo = 1;
        if (hi > end - 1) hi = end - 1;
        pk = lo;
        for (int i = lo; i <= hi; i++)
            if (s_w[i] > mx) { mx = s_w[i]; pk = i; }
    }
    const int a = pk - p->int_rise, b = pk + p->int_fall;
    if (a - 8 < 0 || b >= end) return true;

    /* база x8 - от пробоя порога; e - 32 < 0 только у самого начала
     * буфера, тогда 8 отсчётов перед окном */
    const int e = s_cross_pos - p->trap_L;
    int32_t base8 = 0, sum = 0;
    if (e - 32 >= 0) base8 = shape_base32(e) / 4;
    else for (int i = a - 8; i < a; i++) base8 += s_w[i];
    if (ipk >= 0 && isum >= 0) sum = isum;
    else for (int i = a; i <= b; i++) sum += s_w[i];
    const int32_t n  = b - a + 1;
    const int32_t h8 = mx * 8 - base8;              /* высота x8  */
    const int32_t s8 = sum * 8 - n * base8;         /* площадь x8 */
    /* s8 не больше 609 * 4095 * 8, x10 - в пределах int32 */
    int32_t w10 = h8 > 0 && s8 > 0 ? s8 * 10 / h8 : 0;
    if (w10 > 10 * n) w10 = 10 * n;

    /* гистограмма ширины */
    if (s_whist_win != n) {             /* окно сменилось - она о другом */
        memset(s_whist, 0, sizeof(s_whist));
        s_whist_win = n;
    }
    int hb = (int)(w10 * SHAPE_HB / (10 * n));
    if (hb >= SHAPE_HB) hb = SHAPE_HB - 1;
    s_whist[hb]++;

    /* Эталон. Какие импульсы брать - как запись эталона в BecqMoni: высота
     * от / до (по умолчанию - выше трёх порогов, там шумовых всплесков
     * мало, без верхней границы), зашкалившие - никогда: у них срезана
     * вершина, и форма и ширина не те. Импульс копится в среднюю форму
     * целиком - база и окно, совмещённый по середине фронта и приведённый к
     * своей высоте (x1024): каждый весит одинаково, крупные не перевешивают. */
    if (learn && s_learn && n == s_learn_win && h8 > 0 &&
        (p->shape_lmin > 0 ? h8 >= p->shape_lmin * 8
                           : num >= (int64_t)3 * p->threshold * den) &&
        (p->shape_lmax <= 0 || h8 <= p->shape_lmax * 8)) {
        const int32_t k = s_learn_n;
        bool clip = false;
        for (int i = a - 8; i <= b && !clip; i++)
            clip = s_w[i] >= MCA_ADC_MAX - 1 || s_w[i] == 0;
        if (k < s_learn_need && !clip) {
            s_learn[k] = (int16_t)(w10 > 32767 ? 32767 : w10);
            int c50 = pk;
            while (c50 > e && c50 > a - 8 && s_w[c50 - 1] * 16 - 2 * base8 > h8) c50--;
            for (int i = a - 8; i <= b; i++) {
                const int j = i - c50 + WOFF;
                s_wsum[j] += ((int32_t)s_w[i] * 8 - base8) * 1024 / h8;
                s_wcnt[j]++;
            }
            s_learn_n = k + 1;
        }
    }

    const bool ok = !cmp || (w10 >= s_shape_lo && w10 <= s_shape_hi);

    /* пример для страницы - только если его ждут */
    const int ek = ok ? 0 : 1;
    if (s_ex_want[ek]) {
        mca_shape_ex_t *e = &s_ex[ek];
        e->len = (int16_t)(n + 8);
        e->pre = (int16_t)(8 + p->int_rise);
        e->h   = h8 / 8;
        e->w10 = w10;
        e->ok  = ok;
        for (int i = a - 8, j = 0; i <= b; i++, j++)
            e->v[j] = (int16_t)(((int32_t)s_w[i] * 8 - base8) / 8);
        LOCK();
        s_ex_want[ek] = false;
        s_ex_new[ek]  = true;
        UNLOCK();
    }

    if (!filt) return true;
    s_shp_chk_pend++;
    if (!ok) s_shp_rej_pend++;
    return ok;
}

/* ---- РАЗНОСТЬ ТРАПЕЦИИ ДЛЯ ВСЕГО ЧАНКА ----
 * d[k] = w[k] - w[k-L] - w[k-G] + w[k-G-L], где w = s_w + DSP_TAIL. */

/* Обычным кодом - запасной путь, если векторный не прошёл самопроверку. */
static void IRAM_ATTR diff_scalar(int L, int G, int n)
{
    const uint16_t *w = s_w + DSP_TAIL;
    for (int k = 0; k < n; k++)
        s_d[k] = (int16_t)(w[k] - w[k - L] - w[k - G] + w[k - G - L]);
}

/* ВЕКТОРНО: 8 отсчётов за команду (ESP32-S3, расширение PIE).
 *
 * Поток w[k] выровнен на 16 байт (так подобраны s_work и DSP_TAIL),
 * три других сдвинуты на L, G и G+L отсчётов и читаются невыровненно:
 * EE.LD.128.USAR берёт выровненный блок и запоминает сдвиг в SAR_BYTE,
 * следующий блок читается обычной загрузкой, EE.SRC.Q склеивает из
 * двух нужные 16 байт. Каждый поток ставит свой сдвиг прямо перед своей
 * склейкой, поэтому один регистр SAR_BYTE на троих не мешает.
 *
 * Сложение и вычитание с насыщением 16 бит, но оно не наступает:
 * w от 0 до 4095, все промежуточные значения в пределах ±8190.
 * За концом чанка читается и пишется до 7 лишних отсчётов - на это
 * у s_work и s_d запас. Самое раннее чтение - блок, содержащий
 * w[-G-L] >= s_work + 8, - не выходит за начало массива.
 *
 * noinline: внутри аппаратный цикл loopgtz, а вложенных аппаратных
 * циклов не бывает - функция не должна оказаться внутри чужого. */
static void IRAM_ATTR __attribute__((noinline)) diff_vec(int L, int G, int n)
{
    const uint16_t *pa = s_w + DSP_TAIL;
    const uint16_t *pb = pa - L, *pc = pa - G, *pe = pa - G - L;
    int16_t *pd = s_d;
    int nv = (n + 7) >> 3;
    __asm__ volatile(
        "loopgtz %[nv], 1f\n\t"
        "ee.vld.128.ip     q0, %[pa], 16\n\t"   /* w[k..k+7]            */
        "ee.ld.128.usar.ip q1, %[pb], 16\n\t"   /* w[k-L..]: блок+сдвиг */
        "ee.vld.128.ip     q2, %[pb], 0\n\t"    /*   следующий блок     */
        "ee.src.q          q1, q1, q2\n\t"      /*   склейка            */
        "ee.vsubs.s16      q0, q0, q1\n\t"      /* w - w[-L]            */
        "ee.ld.128.usar.ip q3, %[pc], 16\n\t"
        "ee.vld.128.ip     q4, %[pc], 0\n\t"
        "ee.src.q          q3, q3, q4\n\t"
        "ee.vsubs.s16      q0, q0, q3\n\t"      /*   - w[-G]            */
        "ee.ld.128.usar.ip q5, %[pe], 16\n\t"
        "ee.vld.128.ip     q6, %[pe], 0\n\t"
        "ee.src.q          q5, q5, q6\n\t"
        "ee.vadds.s16      q0, q0, q5\n\t"      /*   + w[-G-L]          */
        "ee.vst.128.ip     q0, %[pd], 16\n\t"
        "1:\n\t"
        : [pa] "+r"(pa), [pb] "+r"(pb), [pc] "+r"(pc), [pe] "+r"(pe),
          [pd] "+r"(pd)
        : [nv] "r"(nv)
        : "memory");
}

/* Самопроверка векторной разности на самом приборе: случайные 12-битные
 * отсчёты и крайние 0/4095 (проверка, что насыщения нет), все сдвиги
 * выравнивания (L и G с разными остатками от деления на 8), разные длины
 * чанка (остаток последней восьмёрки). Сверка с обычной формулой по
 * каждому отсчёту. Не совпало хоть одно - работаем обычным кодом.
 * Вызывать из задачи обработки до первого mca_dsp_process. */
bool mca_dsp_vec_init(void)
{
    s_w = s_work;                       /* самопроверка - на своём буфере */
    static const uint8_t Ls[] = { 1, 2, 3, 5, 7, 8, 13, 20, 33, 64 };
    const int total = (int)(sizeof(s_work) / sizeof(s_w[0]));
    bool ok = true;
    uint32_t x = 0x12345678u;

    for (int set = 0; set < 2 && ok; set++) {
        for (int k = 0; k < total; k++) {
            x = x * 1664525u + 1013904223u;
            s_w[k] = set == 0 ? (uint16_t)((x >> 20) & 0x0FFF)
                                 : (uint16_t)((x >> 31) ? MCA_ADC_MAX : 0);
        }
        for (size_t a = 0; a < sizeof(Ls) && ok; a++) {
            for (int g = 0; g < 3 && ok; g++) {
                int L = Ls[a];
                int G = g == 0 ? L + 3 : (g == 1 ? L + 44 : TRAP_G_MAX);
                if (G > TRAP_G_MAX) G = TRAP_G_MAX;
                if (L + G >= DSP_TAIL - 4) G = DSP_TAIL - 4 - L;
                int n = CAP_CHUNK_SAMPLES - (int)(a & 7);
                diff_vec(L, G, n);
                const uint16_t *w = s_work + DSP_TAIL;
                for (int k = 0; k < n; k++) {
                    int32_t ref = w[k] - w[k - L] - w[k - G] + w[k - G - L];
                    if (s_d[k] != ref) {
                        ESP_LOGE(TAG, "векторная разность разошлась: L=%d G=%d "
                                 "k=%d: %d вместо %ld", L, G, k, s_d[k],
                                 (long)ref);
                        ok = false;
                        break;
                    }
                }
            }
        }
    }
    memset(s_work, 0, sizeof(s_work));
    s_need_prime = true;
    s_vec_ok = ok;
    ESP_LOGI(TAG, "векторная разность трапеции: %s",
             ok ? "самопроверка пройдена, включена"
                : "самопроверка НЕ пройдена - работаем обычным кодом");
    return ok;
}

bool mca_dsp_vec_ok(void) { return s_vec_ok; }

/* Во ВНУТРЕННЕЙ памяти: иначе код горячего цикла тянется из флеш
 * через кэш, и каждый промах останавливает конвейер. Для цикла,
 * выполняемого миллионы раз в секунду, это заметно. */
void IRAM_ATTR mca_dsp_process(const uint16_t *data, size_t n, bool own_head)
{
    /* замер загрузки: такты этого вызова копятся в s_busy_cyc */
    const uint32_t cyc0 = esp_cpu_get_cycle_count();
    mca_params_t p;
    LOCK();
    p = s_par;
    UNLOCK();

    /* идёт очистка гистограммы (mca_dsp_service) - чанк не набираем,
     * после неё фильтр начнёт с прогрева */
    if (s_clr_pos >= 0) {
        s_need_prime = true;
        return;
    }

    if (n > CAP_CHUNK_SAMPLES) n = CAP_CHUNK_SAMPLES;

    const int32_t L = p.trap_L;
    const int32_t G = p.trap_G;
    /* НОРМИРОВКА НА ДЛИНУ ОКНА.
     * Выход трапеции пропорционален L, поэтому без нормировки
     * изменение окна сдвигает весь спектр и приходится заново
     * подбирать сжатие шкалы. Делить на каждом отсчёте дорого,
     * поэтому вместо этого домножаем ПОРОГ (один раз на чанк),
     * а амплитуду делим уже при регистрации события.
     * Так порог и каналы заданы в единицах, не зависящих от L. */
    const int32_t thr = p.threshold * L;

    /* Гистерезис - ДОЛЯ порога, а не вычитаемая единица.
     * Прежний вариант (порог минус 1) означал почти полное
     * отсутствие гистерезиса: повторный запуск разрешался,
     * едва трапеция опускалась на единицу. */
    int32_t hp = p.hysteresis;
    if (hp < 1) hp = 1;
    if (hp > 99) hp = 99;
    const int32_t thr_lo = (int32_t)((int64_t)thr * hp / 100);
    /* Прореживание проверки порога больше не нужно: в быстром цикле
     * сравнение стоит одну инструкцию, дешевле, чем счётчик. Параметр
     * оставлен в интерфейсе для совместимости, но не используется. */
    const bool pileup_on = (p.pileup_pre_pct > 0 && p.pileup_post_pct > 0);

    /* Границы плоской вершины (см. пояснение у flat_avg). */
    int32_t flat_len = 0, flat_from = 0, flat_to = 0;
    if (p.flat_avg && (G - L) >= 16) {
        int32_t plateau = G - L;
        int32_t margin  = plateau / 4;
        if (margin < 1) margin = 1;
        flat_from = L + margin;
        flat_to   = L + plateau - margin;
        if (flat_to > p.search) flat_to = p.search;
        flat_len  = flat_to - flat_from;
        if (flat_len < 1) flat_len = 0;
    }

    /* Склеиваем хвост и новый чанк. Импульсы вниз переворачиваем здесь,
     * один раз: дальше вся обработка видит их как импульсы вверх. Для
     * обычной полярности остаётся прежнее быстрое копирование. */
    /* По месту - в буфере DMA, если он наш (см. s_w) и импульсы вверх. */
    const bool inplace = own_head && !p.polarity && n == CAP_CHUNK_SAMPLES;
    s_w = inplace ? (uint16_t *)data - DSP_TAIL : s_work;
    if (inplace) {
        /* данные уже на месте */
    } else if (p.polarity && ((uintptr_t)data & 3) == 0) {
        /* По два отсчёта за операцию: в 32-битном слове две половины,
         * в каждой 0x0FFF - (v & 0x0FFF). После маски половина не больше
         * 0x0FFF, поэтому вычитание не занимает из соседней половины и
         * результат совпадает с поштучным 4095 - (v & 0x0FFF) бит в бит
         * (проверено перебором, tools/test_dsp.py, уровень 8). Раньше
         * здесь был цикл по одному отсчёту - около 5 тактов на отсчёт,
         * почти треть бюджета на 13 МГц. */
        typedef uint32_t __attribute__((may_alias)) u32a_t;
        const u32a_t *src = (const u32a_t *)data;
        u32a_t *dst = (u32a_t *)(s_work + DSP_TAIL);
        const size_t n2 = n / 2;
        for (size_t k = 0; k < n2; k++)
            dst[k] = 0x0FFF0FFFu - (src[k] & 0x0FFF0FFFu);
        if (n & 1)
            s_w[DSP_TAIL + n - 1] =
                MCA_ADC_MAX - (data[n - 1] & MCA_DATA_MASK);
    } else if (p.polarity) {
        /* невыровненные данные (из DMA такого не бывает) - по одному */
        for (size_t k = 0; k < n; k++)
            s_w[DSP_TAIL + k] = MCA_ADC_MAX - (data[k] & MCA_DATA_MASK);
    } else {
        memcpy(s_work + DSP_TAIL, data, n * sizeof(uint16_t));
    }
    memcpy(s_w, s_tail, DSP_TAIL * sizeof(uint16_t));

    if (s_need_prime) {
        /* Хвост заполняем ПЕРВЫМ отсчётом чанка, а не нулями:
         * так на стыке нет скачка, и трапеция стартует с нуля
         * естественным образом. Берём уже из буфера - с учётом знака. */
        uint16_t v0 = s_w[DSP_TAIL];
        for (int k = 0; k < DSP_TAIL; k++) s_w[k] = v0;
        s_trap = 0;
        s_state = ST_IDLE;
        s_prime_left = L + G + p.search + 4;
        s_need_prime = false;
    }

    /* Разность трапеции для всего чанка сразу. Дальше и прогрев, и цикл
     * ожидания, и поиск вершины, и перезапуск берут готовое d. */
    const uint32_t cyc1 = esp_cpu_get_cycle_count();
    if (s_vec_ok) diff_vec(L, G, (int)n);
    else          diff_scalar(L, G, (int)n);
    const uint32_t cyc2 = esp_cpu_get_cycle_count();

    int32_t trap = s_trap;
    int32_t base_fp = s_base_fp;
    uint64_t pile = 0, dead = 0;

    /* Фильтр формы: эталон годится, только если набран на том же окне и
     * той же частоте - иначе ширина в отсчётах другая, и отбрасывалось бы
     * всё подряд. Мера считается, только когда она кому-то нужна. */
    const uint32_t fclk0 = adc_clk_get_freq();
    const int32_t  swin  = p.int_rise + p.int_fall + 1;
    const bool shape_cmp  = p.shape_ref > 0 && p.shape_win == swin &&
                            p.shape_hz == (int32_t)fclk0;
    const bool shape_filt = shape_cmp && p.shape_on;
    const bool shape_learn = s_learn_need > 0 && s_learn_hz == (int32_t)fclk0;
    const bool shape_need = shape_filt || shape_learn || s_watch_s > 0;
    /* свёртка: эталон есть и набран на этом окне и этой частоте */
    if (p.algo == 2 && s_cr_gen != s_wave_gen) conv_take_wave(&p);
    const bool conv_ok = p.algo == 2 && s_cr_len > 0 && p.shape_ref > 0 &&
                         p.shape_win == swin && p.shape_hz == (int32_t)fclk0;
    s_shape_lo = p.shape_ref - p.shape_ref * p.shape_tol / 100;
    s_shape_hi = p.shape_ref + p.shape_ref * p.shape_tol / 100;

    const int end = DSP_TAIL + (int)n;
    int i = DSP_TAIL;

    /* ========================================================
     * ДВА ЦИКЛА ВМЕСТО ОДНОГО.
     *
     * Почти всё время мы просто ждём события, а переключатель
     * состояний выполнялся на КАЖДОМ отсчёте - лишняя загрузка
     * состояния и ветвление там, где нужно одно сравнение.
     * Теперь ожидание идёт отдельным коротким циклом: фильтр
     * плюс сравнение с порогом, и всё. Обработка события - в
     * медленной ветке, она выполняется редко.
     *
     * Маски тоже нет: бит переполнения больше не заводится
     * в камерный интерфейс, в слове чистые 12 бит.
     * ======================================================== */
    /* Прогрев прокручиваем ОТДЕЛЬНО, до основного цикла: проверять
     * счётчик на каждом отсчёте ради первых десятков - расточительно. */
    while (s_prime_left > 0 && i < end) {
        trap += DD(i);
        s_prime_left--;
        i++;
    }

    /* Базовая линия обновляется РЕДКО и отдельным проходом: раньше
     * условие проверялось на каждом отсчёте внутри горячего цикла. */
    for (int k = DSP_TAIL + 8; k < end; k += 64) {
        int32_t v = s_w[k];
        int32_t base = base_fp >> 8;
        int32_t dev  = v - base;
        if (!s_base_init) {
            base_fp = v << 8;
            s_base_init = true;
        } else if (dev <= p.baseline_win && dev >= -p.baseline_win) {
            base_fp += ((v << 8) - base_fp) >> p.baseline_shift;
            s_base_lost = 0;
        } else if (++s_base_lost > 64) {
            base_fp = v << 8;
            s_base_lost = 0;
        }
    }

    while (i < end) {

        if (s_state == ST_IDLE) {
            /* ---- БЫСТРЫЙ ЦИКЛ ОЖИДАНИЯ ----
             * Разность трапеции d для чанка уже посчитана (векторно,
             * diff_vec), здесь её остаётся накапливать: одно чтение и
             * одно сложение на отсчёт.
             *
             * ВОСЬМЁРКАМИ, порог - один раз по максимуму восьми значений
             * трапеции. Выход из цикла компилятор собирает переходом,
             * который в обычном случае выполняется (обход дальнего j), -
             * пусть это будет раз на восемь отсчётов, а не на четыре.
             * Условие цикла - счётчик, чтобы получился аппаратный loop.
             * Если максимум выше порога, восьмёрка разбирается поштучно:
             * первое пересечение и значение трапеции те же, что при
             * поштучной проверке (проверено на модели, уровень 8). */
            const int16_t *pd = &DD(i);
            const int cnt = end - i;
            const int16_t *p8 = pd;
            int q = cnt >> 3;
            for (; q > 0; q--) {
                const int32_t t0 = trap + p8[0], t1 = t0 + p8[1];
                const int32_t t2 = t1   + p8[2], t3 = t2 + p8[3];
                const int32_t t4 = t3   + p8[4], t5 = t4 + p8[5];
                const int32_t t6 = t5   + p8[6], t7 = t6 + p8[7];
                int32_t m = t0 > t1 ? t0 : t1;
                const int32_t m23 = t2 > t3 ? t2 : t3;
                const int32_t m45 = t4 > t5 ? t4 : t5;
                const int32_t m67 = t6 > t7 ? t6 : t7;
                m = m > m23 ? m : m23;
                m = m > m45 ? m : m45;
                m = m > m67 ? m : m67;
                if (m > thr) break;
                trap = t7;
                p8 += 8;
            }
            int k = (int)(p8 - pd);
            if (q > 0) {
                /* порог пробит внутри этой восьмёрки - ищем, на каком
                 * отсчёте это случилось */
                for (int o = 0; o < 8; o++) {
                    trap += p8[o];
                    if (trap > thr) break;
                    k++;
                }
            } else {
                /* остаток чанка, не кратный восьми */
                for (; k < cnt; k++) {
                    trap += pd[k];
                    if (trap > thr) break;
                }
            }
            i += k;
            if (i >= end) break;

            s_pre_trap = trap;
            s_peak     = trap;
            s_peak_pos = i;
            s_cross_pos = i;
            s_since    = 0;
            s_flat_sum = 0;
            s_flat_cnt = 0;
            s_state    = ST_PEAK;
            i++;
        }

        /* ---- медленная ветка: поиск вершины ---- */
        if (s_state == ST_PEAK) {
            bool done = false;
            if (flat_len == 0) {
                /* Без плато (обычный случай): до конца поиска осталось
                 * search - since отсчётов, их прогоняем коротким циклом -
                 * только трапеция и максимум, в локальных переменных.
                 * Счётчики прибавляются разом после цикла. */
                int m = p.search - s_since;
                if (m > end - i) m = end - i;
                int32_t pk = s_peak, pp = s_peak_pos;
                const int stop = i + m;
                for (; i < stop; i++) {
                    trap += DD(i);
                    if (trap > pk) { pk = trap; pp = i; }
                }
                s_peak = pk;
                s_peak_pos = pp;
                s_since += m;
                dead    += m;      /* поиск вершины - тоже мёртвое время */
                done = (s_since >= p.search);
            } else {
                /* с плато - по одному отсчёту, как раньше */
                while (i < end) {
                    trap += DD(i);
                    dead++;
                    if (trap > s_peak) { s_peak = trap; s_peak_pos = i; }
                    if (s_since >= flat_from && s_since < flat_to) {
                        s_flat_sum += trap;
                        s_flat_cnt++;
                    }
                    i++;
                    if (++s_since >= p.search) { done = true; break; }
                }
            }
            if (done) {
                    bool bad = false;
                    if (pileup_on) {
                        if (s_pre_trap > s_peak * p.pileup_pre_pct / 100)
                            bad = true;
                        if (!bad && trap > s_peak * p.pileup_post_pct / 100)
                            bad = true;
                    }
                    if (bad) {
                        pile++;
                    } else {
                        int64_t num;
                        int32_t den, ipk = -1, isum = 0;
                        if (p.algo == 1) {
                            const int32_t ib = base_fp >> 8;
                            num = amp_integrate(s_peak_pos, p.int_rise,
                                                p.int_fall, L, G, ib,
                                                &den, &ipk);
                            /* сумма окна без вычета базы - для меры формы */
                            isum = (int32_t)(num + (int64_t)den * ib);
                        } else if (conv_ok &&
                                   amp_conv(s_peak_pos, end, &p, &num, &den, &ipk)) {
                            isum = -1;          /* вершина есть, суммы нет */
                        } else {
                            num = (s_flat_cnt > 0)
                                ? (int32_t)(s_flat_sum / s_flat_cnt)
                                : s_peak;
                            den = L;                    /* вершина / L */
                        }
                        if (!shape_need ||
                            shape_check(s_peak_pos, end, num, den, &p,
                                        shape_cmp, shape_filt, shape_learn,
                                        ipk, isum))
                            record_event(num, den, &p);
                    }
                    s_since = 0;
                    s_state = ST_REARM;
            }
            if (i >= end) break;
        }

        /* ---- медленная ветка: мёртвое время ---- */
        if (s_state == ST_REARM) {
            /* Пока с начала фазы меньше rearm отсчётов, условие выхода
             * заведомо ложно - эти отсчёты прогоняем без сравнений.
             * Проверка начинается с того отсчёта, на котором счётчик
             * доходит до rearm, - ровно как в поштучном цикле. */
            int m = p.rearm - 1 - s_since;
            if (m > end - i) m = end - i;
            if (m > 0) {
                const int stop = i + m;
                for (; i < stop; i++)
                    trap += DD(i);
                s_since += m;
                dead    += m;
            }
            for (; i < end; i++) {
                trap += DD(i);
                dead++;
                if (++s_since >= p.rearm && trap < thr_lo) {
                    s_state = ST_IDLE;
                    i++;
                    break;
                }
            }
        }
    }

    /* хвост -> начало буфера для следующего вызова */
    /* memcpy, НЕ memmove: обе - из ПЗУ микросхемы, но memmove там медленный.
     * Прежний перенос хвоста memmove'ом внутри s_work (400 байт на чанк)
     * стоил 2.2 такта на отсчёт - почти пятую часть бюджета на 20 МГц
     * (замер 2026-11-04: «порог и события» 7.29 с memmove, 5.07 с memcpy,
     * всё остальное то же). */
    memcpy(s_tail, s_w + end - DSP_TAIL, DSP_TAIL * sizeof(uint16_t));

    /* Событие, не успевшее завершиться до конца чанка, продолжается
     * в следующем вызове. Но s_peak_pos - это ИНДЕКС В БУФЕРЕ, а
     * буфер только что сдвинулся: без пересчёта индекс указывал бы
     * на чужие отсчёты, и амплитуда считалась бы по пустому месту.
     * Такие события уходили в нулевой канал - на модели это 4 % при
     * search=70 и чанке 1024 (порог срабатывал ближе к концу чанка). */
    if (s_state == ST_PEAK) {
        s_peak_pos  -= (int32_t)(end - DSP_TAIL);
        s_cross_pos -= (int32_t)(end - DSP_TAIL);
        /* Если пик уехал за пределы сохранённого хвоста, мерить
         * нечего: событие бросаем, а не считаем по мусору. */
        if (s_peak_pos < L + G + 1) {
            s_state = ST_IDLE;
            s_since = 0;
        }
    }

    s_trap = trap;
    s_base_fp = base_fp;

    /* длительность чанка - до блокировки: деление 64-битное */
    const uint32_t fclk = adc_clk_get_freq();
    const uint64_t dt_ns = fclk ? (uint64_t)n * 1000000000ULL / fclk : 0;

    const uint32_t cyc3 = esp_cpu_get_cycle_count();
    LOCK();
    s_run_ns               += dt_ns;
    s_st.skipped_pileup    += pile;
    s_st.skipped_deadtime  += dead;
    s_st.samples_processed += n;
    s_st.baseline           = base_fp >> 8;
    s_st.total_events      += s_ev_pend;
    s_st.overflow          += s_ovf_pend;
    s_st.shape_checked     += s_shp_chk_pend;
    s_st.skipped_shape     += s_shp_rej_pend;
    s_busy_cyc   += (uint32_t)(cyc3 - cyc0);
    s_cyc_acc[0] += (uint32_t)(cyc1 - cyc0);   /* копия чанка          */
    s_cyc_acc[1] += (uint32_t)(cyc2 - cyc1);   /* разность трапеции    */
    s_cyc_acc[2] += (uint32_t)(cyc3 - cyc2);   /* порог и события      */
    s_cyc_n      += n;
    UNLOCK();
    s_ev_pend = s_ovf_pend = 0;
    s_shp_chk_pend = s_shp_rej_pend = 0;
}

void mca_dsp_tick_1s(void)
{
    /* CPS - по фактическому времени с прошлого тика, а не на «ровно
     * секунду»: тик из главного цикла под нагрузкой ядра 0 опаздывает, и
     * CPS (на странице и в пакете статуса для программ на ПК) завышался. */
    static int64_t t_cps;
    const int64_t now_cps = esp_timer_get_time();
    const int64_t dt = t_cps ? now_cps - t_cps : 1000000;
    t_cps = now_cps;

    LOCK();
    const uint64_t ev = s_st.total_events - s_last_events;
    s_st.cps = (uint32_t)(dt > 0 ? (ev * 1000000ULL + (uint64_t)dt / 2) /
                                   (uint64_t)dt : ev);
    s_last_events = s_st.total_events;
    s_st.run_ms = (uint32_t)(s_run_ns / 1000000ULL);
    /* После «Сброса» счётчики начались с нуля: ev - уже события с
     * очистки, а время набора - тоже с нуля. */
    {
        const uint64_t rms = s_run_ns / 1000000ULL;
        const uint64_t d = rms >= s_prev_run_ms ? rms - s_prev_run_ms : rms;
        s_prev_run_ms = rms;
        s_sec_counts  = (uint32_t)ev;
        s_sec_dur_ms  = (uint32_t)d;
    }
    s_st.chunks_lost = adc_cap_chunks_lost();
    /* Загрузка = доля тактов ядра, ушедших на обработку, за время с
     * прошлого замера. Близко к 100% - обработка не успевает, пойдут
     * потерянные чанки. */
    int64_t now = esp_timer_get_time();
    if (s_load_t_us > 0 && now > s_load_t_us)
        s_st.load_pm = (uint32_t)(s_busy_cyc * 1000ULL /
                       ((uint64_t)(now - s_load_t_us) *
                        CONFIG_ESP_DEFAULT_CPU_FREQ_MHZ));
    s_busy_cyc  = 0;
    s_load_t_us = now;
    /* такты на отсчёт по этапам (x100) - видно, во что упирается частота */
    for (int i = 0; i < 3; i++) {
        s_st.cyc_x100[i] = s_cyc_n ? (uint32_t)(s_cyc_acc[i] * 100 / s_cyc_n) : 0;
        s_cyc_acc[i] = 0;
    }
    s_cyc_n = 0;
    UNLOCK();
    if (s_watch_s > 0) s_watch_s--;
}

/* ---- фильтр формы: управление из других задач ---- */
void mca_dsp_shape_learn(bool start)
{
    LOCK();
    s_req_learn = start ? 1 : 2;
    const int32_t win = s_par.int_rise + s_par.int_fall + 1;
    UNLOCK();
    ESP_LOGI(TAG, "фильтр формы: набор эталона %s (окно %ld)",
             start ? "начат" : "прерван", (long)win);
}

void mca_dsp_shape_clear_hist(void)
{
    LOCK();
    s_req_hist_clear = true;
    UNLOCK();
}

void mca_dsp_shape_watch(void) { s_watch_s = 10; }

void mca_dsp_shape_info(mca_shape_info_t *o)
{
    LOCK();
    const mca_params_t p = s_par;
    o->learn_n    = s_learn_n;
    o->learn_need = s_req_learn == 1 ? s_par.shape_ln : s_learn_need;
    o->p10 = s_lp10; o->p50 = s_lp50; o->p90 = s_lp90;
    UNLOCK();
    o->win    = p.int_rise + p.int_fall + 1;
    o->active = p.shape_on && p.shape_ref > 0 && p.shape_win == o->win &&
                p.shape_hz == (int32_t)adc_clk_get_freq();
}

/* Без блокировки, как и спектр: пишет только задача обработки, а
 * недописанный столбец картинке не вредит. */
void mca_dsp_shape_hist(uint32_t *dst)
{
    memcpy(dst, s_whist, sizeof(s_whist));
}

/* Средний импульс из сумм набора: ячейки, куда легли не меньше 90 %
 * импульсов (края окна у разных импульсов разные), в тысячных от вершины. */
static void build_wave(int32_t n, mca_shape_wave_t *wv)
{
    int j0 = 0, j1 = -1;
    for (int j = 0; j < WBUF; j++)
        if (s_wcnt[j] > 0 && s_wcnt[j] * 10 >= n * 9) { if (j1 < 0) j0 = j; j1 = j; }
    if (j1 - j0 + 1 > SHAPE_WAVE_MAX) j1 = j0 + SHAPE_WAVE_MAX - 1;
    int pre = j0;
    int64_t top = 1;
    for (int j = j0; j <= j1; j++) {
        const int64_t m = (int64_t)s_wsum[j] * 1000 / s_wcnt[j];
        if (m > top) { top = m; pre = j; }
    }
    wv->len = (int16_t)(j1 >= j0 ? j1 - j0 + 1 : 0);
    wv->pre = (int16_t)(pre - j0);
    wv->mid = (int16_t)(WOFF - j0);
    wv->n   = (int16_t)n;
    for (int j = j0; j <= j1; j++) {
        const int64_t x = (int64_t)s_wsum[j] * 1000 / s_wcnt[j] * 1000 / top;
        wv->v[j - j0] = (int16_t)(x > 32767 ? 32767 : x < -32768 ? -32768 : x);
    }
}

void mca_dsp_shape_wave(mca_shape_wave_t *o)
{
    /* Пока идёт набор - текущее среднее. Суммы в это время дописывает
     * задача обработки: ячейка может прочитаться на импульс раньше или
     * позже - для картинки это не важно. */
    LOCK();
    const int32_t n = s_learn_n, need = s_learn_need;
    UNLOCK();
    if (need > 0 && n > 0) {
        build_wave(n, o);
        return;
    }
    LOCK();
    *o = s_wave;
    UNLOCK();
}

void mca_dsp_shape_set_wave(const mca_shape_wave_t *w)
{
    if (w->len < 0 || w->len > SHAPE_WAVE_MAX || w->pre < 0 || w->pre >= w->len)
        return;
    LOCK();
    s_wave = *w;
    s_wave_gen++;
    UNLOCK();
}

bool mca_dsp_shape_example(int k, mca_shape_ex_t *o)
{
    if (k < 0 || k > 1) return false;
    bool got = false;
    LOCK();
    if (s_ex_new[k]) {
        /* слот не трогается, пока s_ex_want ложно - копия цельная */
        *o = s_ex[k];
        s_ex_new[k]  = false;
        s_ex_want[k] = true;
        got = true;
    }
    UNLOCK();
    return got;
}

static int cmp_i16(const void *a, const void *b)
{
    return *(const int16_t *)a - *(const int16_t *)b;
}

/* Набор закончен - медиана в эталон. Сортировка 2000 чисел - миллисекунды,
 * поэтому здесь, в главной задаче, а не в задаче обработки: та писать в
 * буфер уже перестала (s_learn_n дошёл до s_learn_need). */
bool mca_dsp_shape_poll(void)
{
    static int16_t v[SHAPE_LEARN_N];
    static mca_shape_wave_t wv;
    LOCK();
    const int32_t n = s_learn_n, need = s_learn_need;
    const uint32_t gen = s_learn_gen;
    UNLOCK();
    if (need <= 0 || n < need) return false;
    memcpy(v, s_learn, (size_t)n * sizeof(int16_t));
    qsort(v, (size_t)n, sizeof(int16_t), cmp_i16);
    build_wave(n, &wv);
    bool ok = false;
    LOCK();
    if (gen == s_learn_gen) {           /* набор не начат заново */
        s_lp10 = v[n / 10];
        s_lp50 = v[n / 2];
        s_lp90 = v[n * 9 / 10];
        s_learn_need   = 0;
        s_par.shape_ref = s_lp50;
        s_par.shape_win = s_learn_win;
        s_par.shape_hz  = s_learn_hz;
        s_wave = wv;
        s_wave_gen++;
        /* свёртка меряет новым эталоном: шкала чуть другая - спектр заново */
        if (s_par.algo == 2) s_req_clear = true;
        ok = true;
    }
    UNLOCK();
    if (ok)
        ESP_LOGI(TAG, "фильтр формы: эталон %ld.%ld отсч. (10-90 %%: %ld.%ld-%ld.%ld), окно %ld",
                 (long)(s_lp50 / 10), (long)(s_lp50 % 10), (long)(s_lp10 / 10),
                 (long)(s_lp10 % 10), (long)(s_lp90 / 10), (long)(s_lp90 % 10),
                 (long)s_learn_win);
    return ok;
}

void mca_dsp_last_second(uint32_t *counts, uint32_t *dur_ms)
{
    LOCK();
    *counts = s_sec_counts;
    *dur_ms = s_sec_dur_ms;
    UNLOCK();
}

void mca_dsp_get_params(mca_params_t *out)
{
    LOCK();
    *out = s_par;
    UNLOCK();
}

void mca_dsp_set_params(const mca_params_t *in)
{
    /* Под блокировкой - только копия, границы и флаги запросов. Очистку
     * гистограммы и перезапуск фильтра делает задача обработки
     * (mca_dsp_service), печать в консоль - после блокировки. */
    bool prime, clear;
    LOCK();
    mca_params_t old = s_par;
    s_par = *in;

    if (s_par.trap_L < 1) s_par.trap_L = 1;
    if (s_par.trap_L > TRAP_L_MAX) s_par.trap_L = TRAP_L_MAX;
    if (s_par.trap_G < 1) s_par.trap_G = 1;
    if (s_par.trap_G > TRAP_G_MAX) s_par.trap_G = TRAP_G_MAX;
    /* Сумма окон не должна выходить за хвост рабочего буфера,
     * иначе чтение уйдёт за его начало. */
    /* Зазор ОБЯЗАН быть больше окна, иначе плоской вершины нет
     * и трапеция вырождается в треугольник. */
    if (s_par.trap_G <= s_par.trap_L + 2)
        s_par.trap_G = s_par.trap_L + 3;
    if (s_par.trap_L + s_par.trap_G >= DSP_TAIL - 4)
        s_par.trap_G = DSP_TAIL - 4 - s_par.trap_L;
    if (s_par.search < 1) s_par.search = 1;
    if (s_par.search > 256) s_par.search = 256;
    if (s_par.rearm < 0) s_par.rearm = 0;
    /* Каналов на экране - только 2048/4096/8192. Произвольный ввод
     * приводим к ближайшему разрешённому значению. */
    if (s_par.nch != 2048 && s_par.nch != 4096 && s_par.nch != 8192) {
        if (s_par.nch <= 3072)      s_par.nch = 2048;
        else if (s_par.nch <= 6144) s_par.nch = 4096;
        else                        s_par.nch = 8192;
    }
    if (s_par.cpc_milli < 10)     s_par.cpc_milli = 10;      /* 0.01 кода  */
    if (s_par.cpc_milli > 100000) s_par.cpc_milli = 100000;  /* 100 кодов  */
    if (s_par.algo < 0 || s_par.algo > 2) s_par.algo = 0;
    if (s_par.shape_lmin < 0)    s_par.shape_lmin = 0;
    if (s_par.shape_lmin > 4095) s_par.shape_lmin = 4095;
    if (s_par.shape_lmax < 0)    s_par.shape_lmax = 0;
    if (s_par.shape_lmax > 4095) s_par.shape_lmax = 4095;
    if (s_par.shape_ln < 100)    s_par.shape_ln = 100;
    if (s_par.shape_ln > SHAPE_LEARN_N) s_par.shape_ln = SHAPE_LEARN_N;
    s_par.polarity = s_par.polarity ? 1 : 0;
    if (s_par.int_rise < 0)  s_par.int_rise = 0;
    if (s_par.int_rise > 200) s_par.int_rise = 200;
    if (s_par.int_fall < 1)  s_par.int_fall = 1;
    if (s_par.int_fall > 400) s_par.int_fall = 400;
    if (s_par.baseline_win < 1)    s_par.baseline_win = 1;
    if (s_par.baseline_win > 4095) s_par.baseline_win = 4095;
    s_par.shape_on = s_par.shape_on ? 1 : 0;
    if (s_par.shape_tol < 1)   s_par.shape_tol = 1;
    if (s_par.shape_tol > 200) s_par.shape_tol = 200;
    if (s_par.shape_ref < 0)     s_par.shape_ref = 0;
    if (s_par.shape_ref > 10000) s_par.shape_ref = 10000;

    /* Смена L или G меняет саму передаточную функцию: накопленный
     * аккумулятор становится бессмысленным (в нём слагаемые от старых
     * окон). Сбрасываем - иначе трапеция уедет и не вернётся. */
    /* Смена полярности - то же самое: в буфере и в аккумуляторе лежит
     * сигнал старого знака, и базовую линию надо захватить заново. */
    prime = s_par.trap_L != old.trap_L || s_par.trap_G != old.trap_G ||
            s_par.polarity != old.polarity;
    if (prime) s_req_prime = true;
    /* «Кодов на канал» и способ измерения меняют саму раскладку событий
     * по каналам: старый спектр с новым не складывается - очищаем.
     * Число каналов раскладку не меняет - от него зависит только показ. */
    clear = s_par.cpc_milli != old.cpc_milli || s_par.algo != old.algo;
    if (clear) s_req_clear = true;
    UNLOCK();
    if (prime) ESP_LOGI(TAG, "L/G или полярность изменены -> фильтр перезапустится с прогревом");
    if (clear) ESP_LOGI(TAG, "шкала или способ изменены -> спектр будет очищен");
}

/* Без блокировки. Страница спектра вызывает это до 16 раз на запрос,
 * каждый раз копируя 2 КБ из PSRAM, - под мьютексом, который задача
 * обработки берёт на каждом чанке: на 16 МГц это задерживало её и
 * давало потерянные чанки. В гистограмму пишет только задача обработки
 * (record_event, тоже без блокировки), слово читается целиком, а канал,
 * увеличенный на единицу мгновением позже, картинке не вредит. */
size_t mca_dsp_get_spectrum(uint32_t *dst, size_t from, size_t count)
{
    if (from >= MCA_CHANNELS) return 0;
    if (from + count > MCA_CHANNELS) count = MCA_CHANNELS - from;
    memcpy(dst, s_hist + from, count * sizeof(uint32_t));
    return count;
}

void mca_dsp_get_stats(mca_stats_t *out)
{
    LOCK();
    *out = s_st;
    UNLOCK();
}

void mca_dsp_flush(void)
{
    /* Буфер больше не описывает непрерывный сигнал: между старыми
     * и новыми отсчётами дыра. Не обнуляем его (это само создало бы
     * скачок), а помечаем, что следующий чанк начинается с прогрева.
     * Зовёт только задача обработки - блокировка не нужна. */
    s_state      = ST_IDLE;
    s_since      = 0;
    s_need_prime = true;
}

/* Без мьютекса: одно слово читается атомарно, а знак синхронизации
 * осциллографу нужен на каждом чанке. */
bool mca_dsp_polarity_neg(void)
{
    return s_par.polarity != 0;
}
